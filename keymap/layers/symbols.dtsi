ZMK_LAYER(symbols,
// ╭──────────────────┬──────────────────┬──────────────────┬──────────────────┬──────────────────┬──────────────────╮   ╭──────────────────┬──────────────────┬──────────────────┬──────────────────┬──────────────────┬──────────────────╮
     ___                ___                &kp MINUS          &kp PLUS           &kp HASH           ___                    ___                &kp PERCENT        &kp STAR           &kp KP_DIVIDE      ___                ___
// ├──────────────────├──────────────────┼──────────────────┼──────────────────┼──────────────────┼──────────────────┤   ├──────────────────├──────────────────┼──────────────────┼──────────────────┼──────────────────┼──────────────────┤
     ___                &kp EXCL           &kp LPAR           &kp RPAR           &kp EQUAL          &ht_lgc_pipe 0 0       &ht_lgc_amps 0 0   &mc_colon          &mc_lbrc           &mc_rbrc           &mc_qst            &mc_sqt 
// ├──────────────────├──────────────────┼──────────────────┼──────────────────┼──────────────────┼──────────────────┤   ├──────────────────├──────────────────┼──────────────────┼──────────────────┼──────────────────┼──────────────────┤
     ___                &kp CARET          &mc_lbkt           &mc_rbkt           &ht_at_email 0 0   ___                    ___                &mc_tilda          &mc_less           &mc_greater        &kp DLLR           ___
// ╰──────────────────┴──────────────────┴──────────────────┼──────────────────┼──────────────────┼──────────────────┤   ├──────────────────├──────────────────┼──────────────────┼──────────────────┴──────────────────┴──────────────────╯
                                                              &mc_up_dir         ___                &kp BSLH               ___                ___                ___ 
//                                                          ╰──────────────────┴──────────────────┴──────────────────╯   ╰──────────────────┴──────────────────┴──────────────────╯
)
