ZMK_LAYER(caps_word,
// ╭──────────────────┬──────────────────┬──────────────────┬──────────────────┬──────────────────┬──────────────────╮   ╭──────────────────┬──────────────────┬──────────────────┬──────────────────┬──────────────────┬──────────────────╮
     ___                &kp LS(Q)          &kp LS(W)          &kp LS(E)          &kp LS(R)          &kp LS(T)              &kp LS(Y)          &kp LS(U)          &kp LS(I)          &kp LS(O)          &kp LS(P)          &kp LS(LBKT) 
// ├──────────────────├──────────────────┼──────────────────┼──────────────────┼──────────────────┼──────────────────┤   ├──────────────────├──────────────────┼──────────────────┼──────────────────┼──────────────────┼──────────────────┤
     ___                &hml LGUI LS(A)    &hml LALT LS(S)    &hml LCTRL LS(D)   &hml LSHFT LS(F)   &kp LS(G)              &kp LS(H)          &hmr RSHFT LS(J)   &hmr RCTRL LS(K)   &hmr RALT LS(L)    &hmr RGUI LS(SEMI) &kp LS(SQT) 
// ├──────────────────├──────────────────┼──────────────────┼──────────────────┼──────────────────┼──────────────────┤   ├──────────────────├──────────────────┼──────────────────┼──────────────────┼──────────────────┼──────────────────┤
     ___                &kp LS(Z)          &kp LS(X)          &kp LS(C)          &kp LS(V)          &kp LS(B)              &kp LS(N)          &kp LS(M)          &kp LS(COMMA)      &kp LS(DOT)        &kp SLASH          ___
// ╰──────────────────┴──────────────────┴──────────────────┼──────────────────┼──────────────────┼──────────────────┤   ├──────────────────├──────────────────┼──────────────────┼──────────────────┴──────────────────┴──────────────────╯
                                                              ___                ___                ___                    ___                ___                ___               
//                                                          ╰──────────────────┴──────────────────┴──────────────────╯   ╰──────────────────┴──────────────────┴──────────────────╯
)