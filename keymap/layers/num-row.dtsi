ZMK_LAYER(num_row,
// ╭──────────────────┬──────────────────┬──────────────────┬──────────────────┬──────────────────┬──────────────────╮   ╭──────────────────┬──────────────────┬──────────────────┬──────────────────┬──────────────────┬──────────────────╮
     ___                ___                &kp HASH           &ht_lgc_pipe 0 0   &ht_dbl_fslh 0 0   ___                    ___                &ht_dbl_star 0 0   &ht_lgc_amps 0 0   &ht_dbl_plus 0 0   ___                ___
// ├──────────────────├──────────────────┼──────────────────┼──────────────────┼──────────────────┼──────────────────┤   ├──────────────────├──────────────────┼──────────────────┼──────────────────┼──────────────────┼──────────────────┤
     ___                &hml LGUI N6       &hml LALT N4       &hml LCTRL N2      &hml LSHFT N0      &kp PERCENT            &mc_tilda          &hmr RSHFT N1      &hmr RCTRL N3      &hmr RALT N5       &hmr RGUI N7       ___
// ├──────────────────├──────────────────┼──────────────────┼──────────────────┼──────────────────┼──────────────────┤   ├──────────────────├──────────────────┼──────────────────┼──────────────────┼──────────────────┼──────────────────┤
     ___                &mc_colon          &kp LPAR           &kp RPAR           &kp N8             ___                    ___                &kp N9             &mc_comma          &mc_dot            &kp SEMI           ___
// ╰──────────────────┴──────────────────┴──────────────────┼──────────────────┼──────────────────┼──────────────────┤   ├──────────────────├──────────────────┼──────────────────┼──────────────────┴──────────────────┴──────────────────╯
                                                              ___                ___                ___                    ___                ___                ___
//                                                          ╰──────────────────┴──────────────────┴──────────────────╯   ╰──────────────────┴──────────────────┴──────────────────╯
)
