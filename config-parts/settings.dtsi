&caps_word {  // mods deactivate caps-word, requires PR #1451
    /delete-property/ ignore-modifiers;
};

/*
 * From: https://github.com/urob/zmk
 * Requires PR #1451
 */
&num_word {
    layers = <NUM>;
    continue-list = <
        KP_PLUS KP_MINUS KP_MULTIPLY KP_DIVIDE
        EQUAL PERCENT LPAR RPAR
        KP_N0 KP_N1 KP_N2 KP_N3 KP_N4 KP_N5 KP_N6 KP_N7 KP_N8 KP_N9
    >;
    ignore-modifiers;
};

&lt {
    tapping-term-ms = <300>;

    // Quickly tap-tap-holding the lt button will repeat the tap behavior
    // For example enter-enter-hold, will output multiple enter while you
    // keep holding the key.
    // But holding enter without double tapping, will activate the layer.
    quick-tap-ms = <200>;

    flavor = "balanced";
};

&sk {
    // Deactivate shift on press of next key instead of on release
    // to prevent capitalization of multiple characters when rolling
    // keys (such as `ST`).
    quick-release;
};