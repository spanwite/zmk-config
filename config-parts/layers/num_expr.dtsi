ZMK_LAYER(num_expr,
// ╭───────────────┬───────────────┬───────────────┬───────────────┬───────────────┬───────────────╮   ╭───────────────┬───────────────┬───────────────┬───────────────┬───────────────┬───────────────╮
     ___             ___             &kp N7          &kp N8          &kp N9          ___                 ___             &kp PERCENT     &kp LPAR        &kp RPAR        ___             ___
// ├───────────────├───────────────┼───────────────┼───────────────┼───────────────┼───────────────┤   ├───────────────├───────────────┼───────────────┼───────────────┼───────────────┼───────────────┤
     ___             &hml LGUI N0    &hml LALT N4    &hml LCTRL N5   &hml LSHFT N6   ___                 ___             &hmr RSHFT EQUAL  &hmr RCTRL MINUS  &hmr RALT PLUS  &kp RGUI   ___ 
// ├───────────────├───────────────┼───────────────┼───────────────┼───────────────┼───────────────┤   ├───────────────├───────────────┼───────────────┼───────────────┼───────────────┼───────────────┤
     ___             ___             &kp N1          &kp N2          &kp N3          ___                 ___             &m_dot          &kp STAR        &kp KP_DIVIDE   ___             ___
// ╰───────────────┴───────────────┴───────────────┼───────────────┼───────────────┼───────────────┤   ├───────────────├───────────────┼───────────────┼───────────────┴───────────────┴───────────────╯
                                                     ___             ___             ___                 ___             ___             ___ 
//                                                 ╰───────────────┴───────────────┴───────────────╯   ╰───────────────┴───────────────┴───────────────╯
)