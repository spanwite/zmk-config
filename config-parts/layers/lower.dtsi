ZMK_LAYER(lower,
// ╭──────────────────┬──────────────────┬──────────────────┬──────────────────┬──────────────────┬──────────────────╮   ╭──────────────────┬──────────────────┬──────────────────┬──────────────────┬──────────────────┬──────────────────╮
     ___                ___                &th_lbrc 0 0       &mc_rbrc           &kp DOLLAR         ___                    &kp F12            &kp F7             &kp F8             &kp F9             ___                ___
// ├──────────────────├──────────────────┼──────────────────┼──────────────────┼──────────────────┼──────────────────┤   ├──────────────────├──────────────────┼──────────────────┼──────────────────┼──────────────────┼──────────────────┤
     ___                &mm_qst            &th_lpar 0 0       &th_rpar 0 0       &mc_colon          &mc_pipe               &kp F11            &hmr RSHFT F4      &hmr RCTRL F5      &hmr RALT F6       &kp RGUI           ___
// ├──────────────────├──────────────────┼──────────────────┼──────────────────┼──────────────────┼──────────────────┤   ├──────────────────├──────────────────┼──────────────────┼──────────────────┼──────────────────┼──────────────────┤
     ___                &mm_at_email       &mc_lbkt           &mc_rbkt           &th_dqt 0 0        &kp BACKSLASH          &kp F10            &kp F1             &kp F2             &kp F3             ___                ___
// ╰──────────────────┴──────────────────┴──────────────────┼──────────────────┼──────────────────┼──────────────────┤   ├──────────────────├──────────────────┼──────────────────┼──────────────────┴──────────────────┴──────────────────╯
                                                              ___                ___                ___                    ___                &lt SYMBOLS UNDER  ___
//                                                          ╰──────────────────┴──────────────────┴──────────────────╯   ╰──────────────────┴──────────────────┴──────────────────╯
)

SIMPLE_MORPH(mm_qst, SFT, &mc_qst, &mc_end_qst)
SIMPLE_MORPH(mm_at_email, SFT, &mc_at_sign, &mc_email)
