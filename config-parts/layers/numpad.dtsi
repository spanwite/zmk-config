ZMK_LAYER(numpad,
// ╭──────────────────┬──────────────────┬──────────────────┬──────────────────┬──────────────────┬──────────────────╮   ╭──────────────────┬──────────────────┬──────────────────┬──────────────────┬──────────────────┬──────────────────╮
     ___                &kp F12            &mt F7 N7          &mt F8 N8          &mt F9 N9          ___                    ___                ___                ___                PT_RUN             ___                ___
// ├──────────────────├──────────────────┼──────────────────┼──────────────────┼──────────────────┼──────────────────┤   ├──────────────────├──────────────────┼──────────────────┼──────────────────┼──────────────────┼──────────────────┤
     ___                &mt F11 N0         &mt F4 N4          &mt F5 N5          &mt F6 N6          &kp MINUS              ___                ___                ___                ___                ___                ___
// ├──────────────────├──────────────────┼──────────────────┼──────────────────┼──────────────────┼──────────────────┤   ├──────────────────├──────────────────┼──────────────────┼──────────────────┼──────────────────┼──────────────────┤
     ___                &ht_dot F10 0      &mt F1 N1          &mt F2 N2          &mt F3 N3          ___                    ___                &kp LC(N0)         &kp LC(MINUS)      &kp LC(EQUAL)      ___                ___
// ╰──────────────────┴──────────────────┴──────────────────┼──────────────────┼──────────────────┼──────────────────┤   ├──────────────────├──────────────────┼──────────────────┼──────────────────┴──────────────────┴──────────────────╯
                                                              ___                ___                ___                    ___                ___                ___
//                                                          ╰──────────────────┴──────────────────┴──────────────────╯   ╰──────────────────┴──────────────────┴──────────────────╯
)

HOLDTAP_KEY(ht_dot, &kp, &mc_dot)