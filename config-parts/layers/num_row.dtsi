ZMK_LAYER(num_row,
// ╭──────────────────┬──────────────────┬──────────────────┬──────────────────┬──────────────────┬──────────────────╮   ╭──────────────────┬──────────────────┬──────────────────┬──────────────────┬──────────────────┬──────────────────╮
     ___                ___                &ht_dbl_plus 0 0   &mc_tilda          &kp PERCENT        ___                    ___                &kp HASH           &ht_dbl_fslh 0 0   &ht_dbl_star 0 0   ___                ___
// ├──────────────────├──────────────────┼──────────────────┼──────────────────┼──────────────────┼──────────────────┤   ├──────────────────├──────────────────┼──────────────────┼──────────────────┼──────────────────┼──────────────────┤
     ___                &hml LGUI N6       &hml LALT N4       &hml LCTRL N0      &hml LSHFT N2      &kp HASH               &mc_tilda          &hmr RSHFT N3      &hmr RCTRL N1      &hmr RALT N5       &hmr RGUI N7       ___
// ├──────────────────├──────────────────┼──────────────────┼──────────────────┼──────────────────┼──────────────────┤   ├──────────────────├──────────────────┼──────────────────┼──────────────────┼──────────────────┼──────────────────┤
     ___                &mc_colon          &kp LPAR           &kp RPAR           &kp N8             ___                    ___                &kp N9             &mc_comma          &mc_dot            &kp SEMI           ___
// ╰──────────────────┴──────────────────┴──────────────────┼──────────────────┼──────────────────┼──────────────────┤   ├──────────────────├──────────────────┼──────────────────┼──────────────────┴──────────────────┴──────────────────╯
                                                              ___                ___                ___                    ___                &lt_mc_spc SYMBOLS 0 ___
//                                                          ╰──────────────────┴──────────────────┴──────────────────╯   ╰──────────────────┴──────────────────┴──────────────────╯
)

LAYERTAP_KEY(lt_mc_spc, &mc_spc)

ZMK_BEHAVIOR(num_row_word, caps_word,
    layers = <NUM_ROW>;
    continue-list = <
        PLUS MINUS STAR KP_DIVIDE EQUAL PERCENT LPAR RPAR HASH
        BACKSPACE DELETE
        KP_N0 KP_N1 KP_N2 KP_N3 KP_N4 KP_N5 KP_N6 KP_N7 KP_N8 KP_N9
    >;
    ignore-numbers;
    ignore-modifiers;
)