#define PT_RUN          &kp WIN_MEH(O)
#define PT_COL_PICK     &kp WIN_MEH(C)
#define PT_PIN          &kp WIN_MEH(T)
#define PT_RULLER       &kp WIN_MEH(R)
#define PT_FANCY_ZONES  &kp WIN_MEH(G)
#define PT_EXTRACTOR    &kp WIN_MEH(X)

ZMK_LAYER(powertoys,
// ╭──────────────────┬──────────────────┬──────────────────┬──────────────────┬──────────────────┬──────────────────╮   ╭──────────────────┬──────────────────┬──────────────────┬──────────────────┬──────────────────┬──────────────────╮
     ___                ___                ___                PT_EXTRACTOR       PT_RULLER          ___                    ___                ___                ___                PT_RUN             ___                ___
// ├──────────────────├──────────────────┼──────────────────┼──────────────────┼──────────────────┼──────────────────┤   ├──────────────────├──────────────────┼──────────────────┼──────────────────┼──────────────────┼──────────────────┤
     ___                ___                PT_PIN             PT_COL_PICK        PT_FANCY_ZONES     ___                    ___                ___                ___                ___                ___                ___
// ├──────────────────├──────────────────┼──────────────────┼──────────────────┼──────────────────┼──────────────────┤   ├──────────────────├──────────────────┼──────────────────┼──────────────────┼──────────────────┼──────────────────┤
     ___                ___                ___                ___                ___                ___                    ___                ___                ___                ___                ___                ___
// ╰──────────────────┴──────────────────┴──────────────────┼──────────────────┼──────────────────┼──────────────────┤   ├──────────────────├──────────────────┼──────────────────┼──────────────────┴──────────────────┴──────────────────╯
                                                              ___                ___                ___                    ___                ___                ___ 
//                                                          ╰──────────────────┴──────────────────┴──────────────────╯   ╰──────────────────┴──────────────────┴──────────────────╯
)