ZMK_LAYER(sym,
// ╭───────────────┬───────────────┬───────────────┬───────────────┬───────────────┬───────────────╮   ╭───────────────┬───────────────┬───────────────┬───────────────┬───────────────┬───────────────╮
     ___             ___             &m_lbkt         &m_rbkt         &kp HASH        &m_caret            &kp DOLLAR      &kp PERCENT     &m_less         &m_greater      ___             ___
// ├───────────────├───────────────┼───────────────┼───────────────┼───────────────┼───────────────┤   ├───────────────├───────────────┼───────────────┼───────────────┼───────────────┼───────────────┤
     ___             &mm_qst         &kp LPAR        &kp RPAR        &m_colon        &m_pipe             &m_amps         &kp EQUAL       &hmr RCTRL MINUS  &kp PLUS      &mm_excl        &m_sqt
// ├───────────────├───────────────┼───────────────┼───────────────┼───────────────┼───────────────┤   ├───────────────├───────────────┼───────────────┼───────────────┼───────────────┼───────────────┤
     ___             &kp BACKSLASH   &m_lbrc         &m_rbrc         &mm_at_email    ___                 ___             &kp UNDER       &kp STAR        &kp KP_DIVIDE   ___             ___
// ╰───────────────┴───────────────┴───────────────┼───────────────┼───────────────┼───────────────┤   ├───────────────├───────────────┼───────────────┼───────────────┴───────────────┴───────────────╯
                                                     ___             ___             ___                 ___             ___             ___ 
//                                                 ╰───────────────┴───────────────┴───────────────╯   ╰───────────────┴───────────────┴───────────────╯
)

SIMPLE_MORPH(mm_excl, SFT, &kp EXCL, &m_end_excl)
SIMPLE_MORPH(mm_qst, SFT, &m_qst, &m_end_qst)
SIMPLE_MORPH(mm_at_email, SFT, &kp AT_SIGN, &m_type_email)
