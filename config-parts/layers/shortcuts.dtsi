#define MUTE   &hmr RCTRL C_MUTE
#define VOL_DN &hmr RSHFT C_VOL_DN
#define VOL_UP &hmr RALT  C_VOL_UP

ZMK_LAYER(shortcuts,
// ╭──────────────────┬──────────────────┬──────────────────┬──────────────────┬──────────────────┬──────────────────╮   ╭──────────────────┬──────────────────┬──────────────────┬──────────────────┬──────────────────┬──────────────────╮
     ___                ___                PT_PIN             &kp LG(D)          &kp LA(F4)         PT_FANCY_ZONES         ___                ___                ___                PT_RUN             ___                ___
// ├──────────────────├──────────────────┼──────────────────┼──────────────────┼──────────────────┼──────────────────┤   ├──────────────────├──────────────────┼──────────────────┼──────────────────┼──────────────────┼──────────────────┤
     ___                ___                &kp LG(LC(LEFT))   &kp LG(LC(RIGHT))  &kp LG(TAB)        ___                    ___                ___                ___                ___                ___                ___
// ├──────────────────├──────────────────┼──────────────────┼──────────────────┼──────────────────┼──────────────────┤   ├──────────────────├──────────────────┼──────────────────┼──────────────────┼──────────────────┼──────────────────┤
     ___                ___                PT_EXTRACTOR       PT_RULER           PT_COL_PICK        ___                    ___                &kp LC(N0)         &kp LC(MINUS)      &kp LC(EQUAL)      ___                ___
// ╰──────────────────┴──────────────────┴──────────────────┼──────────────────┼──────────────────┼──────────────────┤   ├──────────────────├──────────────────┼──────────────────┼──────────────────┴──────────────────┴──────────────────╯
                                                              ___                ___                ___                    ___                ___                ___
//                                                          ╰──────────────────┴──────────────────┴──────────────────╯   ╰──────────────────┴──────────────────┴──────────────────╯
)