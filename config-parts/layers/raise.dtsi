ZMK_LAYER(raise,
// ╭───────────────┬───────────────┬───────────────┬───────────────┬───────────────┬───────────────╮   ╭───────────────┬───────────────┬───────────────┬───────────────┬───────────────┬───────────────╮
     ___             ___             &kp N7          &kp N8          &kp N9          ___                 ___             &kp HASH        &mc_less        &mc_greater     ___             ___
// ├───────────────├───────────────┼───────────────┼───────────────┼───────────────┼───────────────┤   ├───────────────├───────────────┼───────────────┼───────────────┼───────────────┼───────────────┤
     ___             &hml LGUI N0    &hml LALT N4    &hml LCTRL N5   &hml LSHFT N6   ___                 &mc_amps        &kp EQUAL       &kp MINUS       &kp PLUS        &mm_excl        &mc_sqt
// ├───────────────├───────────────┼───────────────┼───────────────┼───────────────┼───────────────┤   ├───────────────├───────────────┼───────────────┼───────────────┼───────────────┼───────────────┤
     ___             ___             &kp N1          &kp N2          &kp N3          ___                 &mc_pipe        &kp PERCENT     &kp STAR        &kp KP_DIVIDE   ___             ___
// ╰───────────────┴───────────────┴───────────────┼───────────────┼───────────────┼───────────────┤   ├───────────────├───────────────┼───────────────┼───────────────┴───────────────┴───────────────╯
                                                     ___             &lt_spc SYMBOLS 0  ___                 ___             ___             ___
//                                                 ╰───────────────┴───────────────┴───────────────╯   ╰───────────────┴───────────────┴───────────────╯
)

SIMPLE_MORPH(mm_excl, SFT, &kp EXCL, &mc_end_excl)
