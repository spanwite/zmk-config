#define MUTE   &hmr RCTRL C_MUTE
#define VOL_DN &hmr RSHFT C_VOL_DN
#define VOL_UP &hmr RALT  C_VOL_UP

ZMK_LAYER(media,
// ╭──────────────────┬──────────────────┬──────────────────┬──────────────────┬──────────────────┬──────────────────╮   ╭──────────────────┬──────────────────┬──────────────────┬──────────────────┬──────────────────┬──────────────────╮
     ___                ___                PT_PIN             &kp LG(D)          &kp LA(F4)         PT_FANCY_ZONES         ___                ___                ___                ___                ___                ___
// ├──────────────────├──────────────────┼──────────────────┼──────────────────┼──────────────────┼──────────────────┤   ├──────────────────├──────────────────┼──────────────────┼──────────────────┼──────────────────┼──────────────────┤
     ___                ___                &kp LG(LC(LEFT))   &kp LG(LC(RIGHT))  &kp LG(TAB)        ___                    ___                MUTE               VOL_DN             VOL_UP             PT_MIC             ___
// ├──────────────────├──────────────────┼──────────────────┼──────────────────┼──────────────────┼──────────────────┤   ├──────────────────├──────────────────┼──────────────────┼──────────────────┼──────────────────┼──────────────────┤
     ___                ___                PT_EXTRACTOR       PT_RULER           PT_COL_PICK        ___                    ___                ___                &kp C_PREV         &kp C_NEXT         ___                ___
// ╰──────────────────┴──────────────────┴──────────────────┼──────────────────┼──────────────────┼──────────────────┤   ├──────────────────├──────────────────┼──────────────────┼──────────────────┴──────────────────┴──────────────────╯
                                                              ___                ___                ___                    ___                &kp C_PP           ___
//                                                          ╰──────────────────┴──────────────────┴──────────────────╯   ╰──────────────────┴──────────────────┴──────────────────╯
)