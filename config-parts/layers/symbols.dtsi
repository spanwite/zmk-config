ZMK_LAYER(symbols,
// ╭──────────────────┬──────────────────┬──────────────────┬──────────────────┬──────────────────┬──────────────────╮   ╭──────────────────┬──────────────────┬──────────────────┬──────────────────┬──────────────────┬──────────────────╮
     ___                ___                &kp PERCENT        &kp HASH           &mc_tilda          ___                    ___                &ht_dbl_plus 0 0   &ht_dbl_fslh 0 0   &ht_dbl_star 0 0   ___                ___
// ├──────────────────├──────────────────┼──────────────────┼──────────────────┼──────────────────┼──────────────────┤   ├──────────────────├──────────────────┼──────────────────┼──────────────────┼──────────────────┼──────────────────┤
     ___                &ht_end_excl 0 0   &ht_lpar 0 0       &ht_rpar 0 0       &mc_colon          &ht_lgc_pipe 0 0       &ht_lgc_amps 0 0   &ht_lgc_eql 0 0    &ht_lbrc 0 0       &mc_rbrc           &ht_end_qst 0 0    ___ 
// ├──────────────────├──────────────────┼──────────────────┼──────────────────┼──────────────────┼──────────────────┤   ├──────────────────├──────────────────┼──────────────────┼──────────────────┼──────────────────┼──────────────────┤
     ___                &kp CARET          &mc_less           &ht_grt_arrow 0 0  &ht_at_email 0 0   ___                    ___                ___                &mc_lbkt           &mc_rbkt           &kp DLLR           ___
// ╰──────────────────┴──────────────────┴──────────────────┼──────────────────┼──────────────────┼──────────────────┤   ├──────────────────├──────────────────┼──────────────────┼──────────────────┴──────────────────┴──────────────────╯
                                                              &mc_up_dir         ___                &ht_dbl_bslh 0 0       ___                ___                ___ 
//                                                          ╰──────────────────┴──────────────────┴──────────────────╯   ╰──────────────────┴──────────────────┴──────────────────╯
)
