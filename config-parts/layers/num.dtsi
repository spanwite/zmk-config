ZMK_LAYER(num,
// ╭───────────────┬───────────────┬───────────────┬───────────────┬───────────────┬───────────────╮   ╭───────────────┬───────────────┬───────────────┬───────────────┬───────────────┬───────────────╮
     ___             ___             &kp N7          &kp N8          &kp N9          ___                 ___             ___             &kp LPAR        &kp RPAR        ___             ___
// ├───────────────├───────────────┼───────────────┼───────────────┼───────────────┼───────────────┤   ├───────────────├───────────────┼───────────────┼───────────────┼───────────────┼───────────────┤
     ___             &kp N0          &kp N4          &kp N5          &kp N6          &tog NUM            ___             &hmr RSHIFT EQUAL  &hmr RCTRL MINUS  &hmr RALT PLUS  &kp RGUI   ___ 
// ├───────────────├───────────────┼───────────────┼───────────────┼───────────────┼───────────────┤   ├───────────────├───────────────┼───────────────┼───────────────┼───────────────┼───────────────┤
     ___             ___             &kp N1          &kp N2          &kp N3          ___                 ___             &kp PERCENT     &kp STAR        &kp KP_DIVIDE   ___             ___
// ╰───────────────┴───────────────┴───────────────┼───────────────┼───────────────┼───────────────┤   ├───────────────├───────────────┼───────────────┼───────────────┴───────────────┴───────────────╯
                                                     &kp MINUS        ___            &m_dot              ___             &m_dot          ___ 
//                                                 ╰───────────────┴───────────────┴───────────────╯   ╰───────────────┴───────────────┴───────────────╯
)