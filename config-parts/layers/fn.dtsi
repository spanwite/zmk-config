#define MUTE   &hmr RCTRL C_MUTE
#define VOL_DN &hmr RSHFT C_VOL_DN
#define VOL_UP &hmr RALT  C_VOL_UP

ZMK_LAYER(fn,
// ╭──────────────────┬──────────────────┬──────────────────┬──────────────────┬──────────────────┬──────────────────╮   ╭──────────────────┬──────────────────┬──────────────────┬──────────────────┬──────────────────┬──────────────────╮
     ___                ___                &kp F7             &kp F8             &kp F9             &kp F12                ___                ___                PT_MIC             ___                ___                ___
// ├──────────────────├──────────────────┼──────────────────┼──────────────────┼──────────────────┼──────────────────┤   ├──────────────────├──────────────────┼──────────────────┼──────────────────┼──────────────────┼──────────────────┤
     ___                ___                &kp F4             &kp F5             &kp F6             &kp F11                ___                VOL_DN             MUTE               VOL_UP             &kp RGUI           ___
// ├──────────────────├──────────────────┼──────────────────┼──────────────────┼──────────────────┼──────────────────┤   ├──────────────────├──────────────────┼──────────────────┼──────────────────┼──────────────────┼──────────────────┤
     ___                ___                &kp F1             &kp F2             &kp F3             &kp F10                ___                &kp C_PREV         &kp C_PP           &kp C_NEXT         ___                ___
// ╰──────────────────┴──────────────────┴──────────────────┼──────────────────┼──────────────────┼──────────────────┤   ├──────────────────├──────────────────┼──────────────────┼──────────────────┴──────────────────┴──────────────────╯
                                                              ___                ___                ___                    ___                ___                ___
//                                                          ╰──────────────────┴──────────────────┴──────────────────╯   ╰──────────────────┴──────────────────┴──────────────────╯
)