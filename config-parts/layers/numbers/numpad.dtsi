ZMK_LAYER(numpad,
// ╭──────────────────┬──────────────────┬──────────────────┬──────────────────┬──────────────────┬──────────────────╮   ╭──────────────────┬──────────────────┬──────────────────┬──────────────────┬──────────────────┬──────────────────╮
     ___                ___                &kp N7             &kp N8             &kp N9             ___                    ___                &msc SCRL_DOWN     &mmv MOVE_UP       &msc SCRL_UP       ___                ___           
// ├──────────────────├──────────────────┼──────────────────┼──────────────────┼──────────────────┼──────────────────┤   ├──────────────────├──────────────────┼──────────────────┼──────────────────┼──────────────────┼──────────────────┤
     ___                &kp N0             &kp N4             &kp N5             &kp N6             ___                    &msc SCRL_LEFT     &mmv MOVE_LEFT     &mmv MOVE_DOWN     &mmv MOVE_RIGHT    &mkp RCLK          &msc SCRL_RIGHT 
// ├──────────────────├──────────────────┼──────────────────┼──────────────────┼──────────────────┼──────────────────┤   ├──────────────────├──────────────────┼──────────────────┼──────────────────┼──────────────────┼──────────────────┤
     ___                ___                &kp N1             &kp N2             &kp N3             ___                    ___                &mkp MB4           &mkp MCLK          &mkp MB5           ___                ___
// ╰──────────────────┴──────────────────┴──────────────────┼──────────────────┼──────────────────┼──────────────────┤   ├──────────────────├──────────────────┼──────────────────┼──────────────────┴──────────────────┴──────────────────╯
                                                              ___                &ht_dot_minus 0 0  ___                    ___                &mkp LCLK          ___ 
//                                                          ╰──────────────────┴──────────────────┴──────────────────╯   ╰──────────────────┴──────────────────┴──────────────────╯
)

MACRO_0_MS(mc_minus, &kp MINUS)
HOLDTAP_KEY(ht_dot_minus, &mc_minus, &mc_dot)

ZMK_BEHAVIOR(smart_numpad, caps_word,
    layers = <NUMPAD>;
    continue-list = <
        PLUS MINUS STAR KP_DIVIDE EQUAL PERCENT LPAR RPAR
        BACKSPACE DELETE
        MOVE_UP MOVE_DOWN MOVE_LEFT MOVE_RIGHT SCRL_UP SCRL_DOWN SCRL_LEFT SCRL_RIGHT MB4 MB5 LCLK RCLK
        KP_N0 KP_N1 KP_N2 KP_N3 KP_N4 KP_N5 KP_N6 KP_N7 KP_N8 KP_N9
    >;
    ignore-numbers;
    ignore-modifiers;
)