ZMK_LAYER(alpha,
// ╭──────────────────┬──────────────────┬──────────────────┬──────────────────┬──────────────────┬──────────────────╮   ╭──────────────────┬──────────────────┬──────────────────┬──────────────────┬──────────────────┬──────────────────╮
     WIN_POWER          &mc_q              &mc_w              &mc_e              &mc_r              &mc_t                  &mc_y              &mc_u              &mc_i              &mc_o              &mc_p              &mc_a_lbkt
// ├──────────────────├──────────────────┼──────────────────┼──────────────────┼──────────────────┼──────────────────┤   ├──────────────────├──────────────────┼──────────────────┼──────────────────┼──────────────────┼──────────────────┤
     CHANGE_LANG        &hml LGUI A        &hml LALT S        &hml LCTRL D       &hml LSHFT F       &mc_g                  &mc_h              &hmr RSHFT J       &hmr RCTRL K       &hmr RALT L        &hmr RGUI SEMI     &mc_a_sqt 
// ├──────────────────├──────────────────┼──────────────────┼──────────────────┼──────────────────┼──────────────────┤   ├──────────────────├──────────────────┼──────────────────┼──────────────────┼──────────────────┼──────────────────┤
     &kp ESC            &mc_z              &mc_x              &mc_c              &mc_v              &mc_b                  &mc_n              &mc_m              &mc_a_comma        &mc_a_dot          &kp SLASH          &td_profiles
// ╰──────────────────┴──────────────────┴──────────────────┼──────────────────┼──────────────────┼──────────────────┤   ├──────────────────├──────────────────┼──────────────────┼──────────────────┴──────────────────┴──────────────────╯
                                                              &lt_to SHORTCUTS ALPHA &lt_spc NAV 0  &lt_caps FN 0       &lt_num_row NUM_ROW 0 &lt_shft SYMBOLS 0 &lt_to SYSTEM 0                 
//                                                          ╰──────────────────┴──────────────────┴──────────────────╯   ╰──────────────────┴──────────────────┴──────────────────╯
)

ZMK_BEHAVIOR(td_profiles, tap_dance,
    tapping-term-ms = <400>;
    bindings = <&to VLC_PLAYER>, <&to GAME_FPS>;
)