ZMK_LAYER(game_fps,
// ╭──────────────────┬──────────────────┬──────────────────┬──────────────────┬──────────────────┬──────────────────╮   ╭──────────────────┬──────────────────┬──────────────────┬──────────────────┬──────────────────┬──────────────────╮
     AMD_SCRNSHT        &kp ESC            &kp Q              &kp W              &kp E              &kp R                  ___                ___                &kp UP             ___                ___                ___
// ├──────────────────├──────────────────┼──────────────────┼──────────────────┼──────────────────┼──────────────────┤   ├──────────────────├──────────────────┼──────────────────┼──────────────────┼──────────────────┼──────────────────┤
     &kp LA(TAB)        &kp LSHIFT         &kp A              &kp S              &kp D              &kp F                  ___                &kp LEFT           &kp DOWN           &kp RIGHT          ___                ___
// ├──────────────────├──────────────────┼──────────────────┼──────────────────┼──────────────────┼──────────────────┤   ├──────────────────├──────────────────┼──────────────────┼──────────────────┼──────────────────┼──────────────────┤
     &to ALPHA          &kp Z              &kp X              &kp C              &kp V              &kp B                  ___                ___                ___                ___                ___                ___
// ╰──────────────────┴──────────────────┴──────────────────┼──────────────────┼──────────────────┼──────────────────┤   ├──────────────────├──────────────────┼──────────────────┼──────────────────┴──────────────────┴──────────────────╯
                                                              &kp LCTRL          &kp SPACE          &kp J                  ___                &sl NUMPAD         ___
//                                                          ╰──────────────────┴──────────────────┴──────────────────╯   ╰──────────────────┴──────────────────┴──────────────────╯
)
