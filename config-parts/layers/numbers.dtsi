ZMK_LAYER(numbers,
// ╭──────────────────┬──────────────────┬──────────────────┬──────────────────┬──────────────────┬──────────────────╮   ╭──────────────────┬──────────────────┬──────────────────┬──────────────────┬──────────────────┬──────────────────╮
     ___                ___                &kp N7             &kp N8             &kp N9             ___                    ___                &mc_tilda          &mc_colon          &kp HASH           ___                ___           
// ├──────────────────├──────────────────┼──────────────────┼──────────────────┼──────────────────┼──────────────────┤   ├──────────────────├──────────────────┼──────────────────┼──────────────────┼──────────────────┼──────────────────┤
     ___                &kp N3             &kp N2             &kp N1             &kp N0             &kp MINUS              ___                &kp PLUS           &kp MINUS          &kp STAR           &kp KP_DIVIDE      ___ 
// ├──────────────────├──────────────────┼──────────────────┼──────────────────┼──────────────────┼──────────────────┤   ├──────────────────├──────────────────┼──────────────────┼──────────────────┼──────────────────┼──────────────────┤
     ___                ___                &kp N4             &kp N5             &kp N6             ___                    ___                &kp EQUAL          &kp LPAR           &kp RPAR           &kp PERCENT        ___
// ╰──────────────────┴──────────────────┴──────────────────┼──────────────────┼──────────────────┼──────────────────┤   ├──────────────────├──────────────────┼──────────────────┼──────────────────┴──────────────────┴──────────────────╯
                                                              ___                ___                &mc_dot                ___                &mc_dot            ___ 
//                                                          ╰──────────────────┴──────────────────┴──────────────────╯   ╰──────────────────┴──────────────────┴──────────────────╯
)

ZMK_BEHAVIOR(num_expr, caps_word,
    layers = <NUMBERS>;
    continue-list = <
        PLUS MINUS STAR KP_DIVIDE EQUAL PERCENT LPAR RPAR HASH
        BACKSPACE DELETE
        KP_N0 KP_N1 KP_N2 KP_N3 KP_N4 KP_N5 KP_N6 KP_N7 KP_N8 KP_N9
    >;
    ignore-numbers;
    ignore-modifiers;
)