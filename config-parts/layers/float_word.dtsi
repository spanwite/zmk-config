ZMK_LAYER(float_word,
// ╭──────────────────┬──────────────────┬──────────────────┬──────────────────┬──────────────────┬──────────────────╮   ╭──────────────────┬──────────────────┬──────────────────┬──────────────────┬──────────────────┬──────────────────╮
     ___                ___                &kp N7             &kp N8             &kp N9             ___                    ___                ___                ___                ___                ___                ___           
// ├──────────────────├──────────────────┼──────────────────┼──────────────────┼──────────────────┼──────────────────┤   ├──────────────────├──────────────────┼──────────────────┼──────────────────┼──────────────────┼──────────────────┤
     ___                &kp N0             &kp N4             &kp N5             &kp N6             ___                    ___                ___                ___                ___                ___                ___ 
// ├──────────────────├──────────────────┼──────────────────┼──────────────────┼──────────────────┼──────────────────┤   ├──────────────────├──────────────────┼──────────────────┼──────────────────┼──────────────────┼──────────────────┤
     ___                &kp MINUS          &kp N1             &kp N2             &kp N3             ___                    ___                ___                ___                ___                ___                ___
// ╰──────────────────┴──────────────────┴──────────────────┼──────────────────┼──────────────────┼──────────────────┤   ├──────────────────├──────────────────┼──────────────────┼──────────────────┴──────────────────┴──────────────────╯
                                                              ___                &lt_dot NAV 0      ___                    ___                ___                ___ 
//                                                          ╰──────────────────┴──────────────────┴──────────────────╯   ╰──────────────────┴──────────────────┴──────────────────╯
)

LAYERTAP_KEY(lt_dot, &mc_dot)

ZMK_BEHAVIOR(float_word, caps_word,
    layers = <FLOAT_WORD>;
    continue-list = <
        PLUS MINUS STAR KP_DIVIDE EQUAL PERCENT LPAR RPAR
        BACKSPACE DELETE
        KP_N0 KP_N1 KP_N2 KP_N3 KP_N4 KP_N5 KP_N6 KP_N7 KP_N8 KP_N9
    >;
    ignore-numbers;
    ignore-modifiers;
)