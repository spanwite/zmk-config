ZMK_LAYER(hand_num,
// ╭──────────────────┬──────────────────┬──────────────────┬──────────────────┬──────────────────┬──────────────────╮   ╭──────────────────┬──────────────────┬──────────────────┬──────────────────┬──────────────────┬──────────────────╮
     ___                ___                &kp N9             &kp N8             &kp N7             ___                    ___                ___                ___                ___                ___                ___           
// ├──────────────────├──────────────────┼──────────────────┼──────────────────┼──────────────────┼──────────────────┤   ├──────────────────├──────────────────┼──────────────────┼──────────────────┼──────────────────┼──────────────────┤
     ___                &kp N0             &kp N3             &kp N2             &kp N1            ___                    ___                ___                ___                ___                ___                ___ 
// ├──────────────────├──────────────────┼──────────────────┼──────────────────┼──────────────────┼──────────────────┤   ├──────────────────├──────────────────┼──────────────────┼──────────────────┼──────────────────┼──────────────────┤
     ___                ___                &kp N6             &kp N5             &kp N4             ___                    ___                ___                ___                ___                ___                ___
// ╰──────────────────┴──────────────────┴──────────────────┼──────────────────┼──────────────────┼──────────────────┤   ├──────────────────├──────────────────┼──────────────────┼──────────────────┴──────────────────┴──────────────────╯
                                                              ___                &lt_sl_sym NAV HAND_SYM   ___             ___                ___                ___ 
//                                                          ╰──────────────────┴──────────────────┴──────────────────╯   ╰──────────────────┴──────────────────┴──────────────────╯
)

LAYERTAP_KEY(lt_sl_sym, &sl)

ZMK_BEHAVIOR(hand_num, caps_word,
    layers = <HAND_NUM>;
    continue-list = <
        PLUS MINUS STAR KP_DIVIDE EQUAL PERCENT LPAR RPAR
        BACKSPACE DELETE
        KP_N0 KP_N1 KP_N2 KP_N3 KP_N4 KP_N5 KP_N6 KP_N7 KP_N8 KP_N9
    >;
    ignore-numbers;
    ignore-modifiers;
)