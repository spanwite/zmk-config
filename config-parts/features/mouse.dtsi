#define ZMK_MOUSE_DEFAULT_MOVE_VAL 3000 
#define ZMK_MOUSE_DEFAULT_SCRL_VAL 20

&mmv {
    acceleration-exponent = <1>;
    time-to-max-speed-ms = <500>;
    delay-ms = <0>;
};

&msc {
    acceleration-exponent = <1>;
    time-to-max-speed-ms = <40>;
    delay-ms = <0>;
};

ZMK_BEHAVIOR(mouse_word, caps_word,
    layers = <MOUSE>;
    continue-list = <
        ESCAPE TAB ENTER
        BACKSPACE DELETE
        MOVE_UP MOVE_DOWN MOVE_LEFT MOVE_RIGHT SCRL_UP SCRL_DOWN SCRL_LEFT SCRL_RIGHT MB4 MB5 LCLK RCLK
    >;
    ignore-modifiers;
)