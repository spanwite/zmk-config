ZMK_LAYER(symbols,
// ╭──────────────────┬──────────────────┬──────────────────┬──────────────────┬──────────────────┬──────────────────╮   ╭──────────────────┬──────────────────┬──────────────────┬──────────────────┬──────────────────┬──────────────────╮
     ___                ___                &mc_tilda          &kp HASH           &kp PERCENT        ___                    ___                &ht_dbl_fslh 0 0   &ht_dbl_star 0 0   &ht_dbl_plus 0 0   ___                ___
// ├──────────────────├──────────────────┼──────────────────┼──────────────────┼──────────────────┼──────────────────┤   ├──────────────────├──────────────────┼──────────────────┼──────────────────┼──────────────────┼──────────────────┤
     ___                &ht_end_excl 0 0   &kp LPAR           &kp RPAR           &kp EQUAL          &ht_lgc_pipe 0 0       &ht_lgc_amps 0 0   &mc_colon          &kp LBRC           &kp RBRC           &ht_end_qst 0 0    &mc_sqt 
// ├──────────────────├──────────────────┼──────────────────┼──────────────────┼──────────────────┼──────────────────┤   ├──────────────────├──────────────────┼──────────────────┼──────────────────┼──────────────────┼──────────────────┤
     ___                &kp CARET          &kp LBKT           &kp RBKT           &ht_at_email 0 0   ___                    ___                ___                &mc_less           &mc_greater        &kp DLLR           ___
// ╰──────────────────┴──────────────────┴──────────────────┼──────────────────┼──────────────────┼──────────────────┤   ├──────────────────├──────────────────┼──────────────────┼──────────────────┴──────────────────┴──────────────────╯
                                                              &mc_up_dir         ___                &ht_dbl_bslh 0 0       ___                ___                ___ 
//                                                          ╰──────────────────┴──────────────────┴──────────────────╯   ╰──────────────────┴──────────────────┴──────────────────╯
)