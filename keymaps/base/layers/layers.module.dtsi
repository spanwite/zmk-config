#include "./alpha/alpha.module.dtsi"
#include "./caps-word/caps-word.module.dtsi"
#include "./numpad/numpad.module.dtsi"
#include "./num-row/num-row.module.dtsi"
#include "./mouse/mouse.module.dtsi"
#include "./nav/nav.module.dtsi"
#include "./symbols/symbols.module.dtsi"
#include "./shortcuts/shortcuts.module.dtsi"
#include "./fn/fn.module.dtsi"
#include "./game-fps/game-fps.module.dtsi"
#include "./vlc-player/vlc-player.module.dtsi"
#include "./system/system.module.dtsi"