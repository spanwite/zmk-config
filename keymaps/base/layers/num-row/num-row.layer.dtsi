ZMK_LAYER(num_row,
// ╭──────────────────┬──────────────────┬──────────────────┬──────────────────┬──────────────────┬──────────────────╮   ╭──────────────────┬──────────────────┬──────────────────┬──────────────────┬──────────────────┬──────────────────╮
     ___                ___                &mc_tilda          &kp HASH           &kp PERCENT        ___                    ___                &ht_dbl_fslh 0 0   &ht_dbl_star 0 0   &ht_dbl_plus 0 0   ___                ___
// ├──────────────────├──────────────────┼──────────────────┼──────────────────┼──────────────────┼──────────────────┤   ├──────────────────├──────────────────┼──────────────────┼──────────────────┼──────────────────┼──────────────────┤
     ___                &hml LGUI N6       &hml LALT N4       &hml LCTRL N2      &hml LSHFT N0      &ht_lgc_pipe 0 0       &ht_lgc_amps 0 0   &hmr RSHFT N1      &hmr RCTRL N3      &hmr RALT N5       &hmr RGUI N7       ___
// ├──────────────────├──────────────────┼──────────────────┼──────────────────┼──────────────────┼──────────────────┤   ├──────────────────├──────────────────┼──────────────────┼──────────────────┼──────────────────┼──────────────────┤
     ___                &mc_colon          &kp LPAR           &kp RPAR           &kp N8             ___                    ___                &kp N9             &mc_comma          &mc_dot            &kp SEMI           ___
// ╰──────────────────┴──────────────────┴──────────────────┼──────────────────┼──────────────────┼──────────────────┤   ├──────────────────├──────────────────┼──────────────────┼──────────────────┴──────────────────┴──────────────────╯
                                                              ___                ___                ___                    ___                &lt_mc_spc SYMBOLS 0 ___
//                                                          ╰──────────────────┴──────────────────┴──────────────────╯   ╰──────────────────┴──────────────────┴──────────────────╯
)