ZMK_LAYER(Mehs,
// ╭──────────────────┬──────────────────┬──────────────────┬──────────────────┬──────────────────┬──────────────────╮   ╭──────────────────┬──────────────────┬──────────────────┬──────────────────┬──────────────────┬──────────────────╮
     XXX                XXX                MAKE_MEH(W)        MAKE_MEH(E)        MAKE_MEH(R)        MAKE_MEH(T)            MAKE_MEH(Y)        MAKE_MEH(U)        MAKE_MEH(I)        MAKE_MEH(O)        XXX                XXX 
// ├──────────────────├──────────────────┼──────────────────┼──────────────────┼──────────────────┼──────────────────┤   ├──────────────────├──────────────────┼──────────────────┼──────────────────┼──────────────────┼──────────────────┤
     XXX                MAKE_MEH(A)        MAKE_MEH(S)        MAKE_MEH(D)        MAKE_MEH(F)        MAKE_MEH(G)            MAKE_MEH(H)        MAKE_MEH(J)        MAKE_MEH(K)        MAKE_MEH(L)        MAKE_MEH(SEMI)     XXX 
// ├──────────────────├──────────────────┼──────────────────┼──────────────────┼──────────────────┼──────────────────┤   ├──────────────────├──────────────────┼──────────────────┼──────────────────┼──────────────────┼──────────────────┤
     ___                MAKE_MEH(Z)        MAKE_MEH(X)        MAKE_MEH(C)        MAKE_MEH(V)        MAKE_MEH(B)            MAKE_MEH(N)        MAKE_MEH(M)        MAKE_MEH(COMMA)    MAKE_MEH(DOT)      MAKE_MEH(SLASH)    XXX 
// ╰──────────────────┴──────────────────┴──────────────────┼──────────────────┼──────────────────┼──────────────────┤   ├──────────────────├──────────────────┼──────────────────┼──────────────────┴──────────────────┴──────────────────╯
                                                              ___                MAKE_MEH(LBKT)      ___                    ___               MAKE_MEH(RBKT)     ___
//                                                          ╰──────────────────┴──────────────────┴──────────────────╯   ╰──────────────────┴──────────────────┴──────────────────╯
)

ZMK_LAYER(Lock,
// ╭──────────────────┬──────────────────┬──────────────────┬──────────────────┬──────────────────┬──────────────────╮   ╭──────────────────┬──────────────────┬──────────────────┬──────────────────┬──────────────────┬──────────────────╮
     XXX                XXX                XXX                XXX                XXX                XXX                    XXX                XXX                XXX                XXX                XXX                XXX
// ├──────────────────├──────────────────┼──────────────────┼──────────────────┼──────────────────┼──────────────────┤   ├──────────────────├──────────────────┼──────────────────┼──────────────────┼──────────────────┼──────────────────┤
     XXX                XXX                XXX                XXX                XXX                XXX                    XXX                XXX                XXX                XXX                XXX                XXX
// ├──────────────────├──────────────────┼──────────────────┼──────────────────┼──────────────────┼──────────────────┤   ├──────────────────├──────────────────┼──────────────────┼──────────────────┼──────────────────┼──────────────────┤
     XXX                XXX                XXX                XXX                XXX                XXX                    XXX                XXX                XXX                XXX                XXX                XXX
// ╰──────────────────┴──────────────────┴──────────────────┼──────────────────┼──────────────────┼──────────────────┤   ├──────────────────├──────────────────┼──────────────────┼──────────────────┴──────────────────┴──────────────────╯
                                                              XXX                XXX                XXX                    &mo UNLOCK         XXX                XXX 
//                                                          ╰──────────────────┴──────────────────┴──────────────────╯   ╰──────────────────┴──────────────────┴──────────────────╯
)

ZMK_LAYER(Unlock,
// ╭──────────────────┬──────────────────┬──────────────────┬──────────────────┬──────────────────┬──────────────────╮   ╭──────────────────┬──────────────────┬──────────────────┬──────────────────┬──────────────────┬──────────────────╮
     XXX                XXX                XXX                XXX                XXX                XXX                    XXX                XXX                XXX                XXX                XXX                XXX
// ├──────────────────├──────────────────┼──────────────────┼──────────────────┼──────────────────┼──────────────────┤   ├──────────────────├──────────────────┼──────────────────┼──────────────────┼──────────────────┼──────────────────┤
     XXX                XXX                XXX                XXX                XXX                XXX                    XXX                XXX                XXX                XXX                XXX                XXX
// ├──────────────────├──────────────────┼──────────────────┼──────────────────┼──────────────────┼──────────────────┤   ├──────────────────├──────────────────┼──────────────────┼──────────────────┼──────────────────┼──────────────────┤
     XXX                XXX                XXX                XXX                XXX                XXX                    XXX                XXX                XXX                XXX                XXX                XXX
// ╰──────────────────┴──────────────────┴──────────────────┼──────────────────┼──────────────────┼──────────────────┤   ├──────────────────├──────────────────┼──────────────────┼──────────────────┴──────────────────┴──────────────────╯
                                                              XXX                XXX                &to ALPHA              XXX                XXX                XXX 
//                                                          ╰──────────────────┴──────────────────┴──────────────────╯   ╰──────────────────┴──────────────────┴──────────────────╯
)
