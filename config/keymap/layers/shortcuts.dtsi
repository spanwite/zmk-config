ZMK_LAYER(Shorts,
// ╭──────────────────┬──────────────────┬──────────────────┬──────────────────┬──────────────────┬──────────────────╮   ╭──────────────────┬──────────────────┬──────────────────┬──────────────────┬──────────────────┬──────────────────╮
     ___                ___                &kp C_PREV         &kp C_NEXT         &kp C_PP           ___                    ___                ___                ___                ___                ___                ___
// ├──────────────────├──────────────────┼──────────────────┼──────────────────┼──────────────────┼──────────────────┤   ├──────────────────├──────────────────┼──────────────────┼──────────────────┼──────────────────┼──────────────────┤
     ___                ___                &kp LG(LC(LEFT))   &kp LG(LC(RIGHT))  &kp LG(TAB)        ___                    ___                ___                ___                ___                ___                ___
// ├──────────────────├──────────────────┼──────────────────┼──────────────────┼──────────────────┼──────────────────┤   ├──────────────────├──────────────────┼──────────────────┼──────────────────┼──────────────────┼──────────────────┤
     ___                ___                ___                ___                ___                ___                    ___                &kp LC(N0)         &kp LC(MINUS)      &kp LC(EQUAL)      ___                ___
// ╰──────────────────┴──────────────────┴──────────────────┼──────────────────┼──────────────────┼──────────────────┤   ├──────────────────├──────────────────┼──────────────────┼──────────────────┴──────────────────┴──────────────────╯
                                                              ___                ___                ___                    ___                ___                ___
//                                                          ╰──────────────────┴──────────────────┴──────────────────╯   ╰──────────────────┴──────────────────┴──────────────────╯
)
