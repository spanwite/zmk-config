ZMK_LAYER(Sym,
// ╭──────────────────┬──────────────────┬──────────────────┬──────────────────┬──────────────────┬──────────────────╮   ╭──────────────────┬──────────────────┬──────────────────┬──────────────────┬──────────────────┬──────────────────╮
     ___                ___                &kp PLUS           &kp MINUS          &kp HASH           ___                    ___                &mc_tilde          &kp KP_DIVIDE      &kp STAR           ___                ___
// ├──────────────────├──────────────────┼──────────────────┼──────────────────┼──────────────────┼──────────────────┤   ├──────────────────├──────────────────┼──────────────────┼──────────────────┼──────────────────┼──────────────────┤
     ___                &kp EXCL           &kp LPAR           &kp RPAR           &kp EQUAL          &mc_pipe               &mc_amps           &mc_colon          &mc_lbrc           &mc_rbrc           &mc_qst            &mc_semi 
// ├──────────────────├──────────────────┼──────────────────┼──────────────────┼──────────────────┼──────────────────┤   ├──────────────────├──────────────────┼──────────────────┼──────────────────┼──────────────────┼──────────────────┤
     ___                &mc_caret          &mc_lbkt           &mc_rbkt           &ht_at_email 0 0   ___                    ___                &kp PERCENT        &mc_less           &mc_greater        &mc_dllr           ___
// ╰──────────────────┴──────────────────┴──────────────────┼──────────────────┼──────────────────┼──────────────────┤   ├──────────────────├──────────────────┼──────────────────┼──────────────────┴──────────────────┴──────────────────╯
                                                              &mc_up_dir         ___                &kp BSLH               ___                ___                ___
//                                                          ╰──────────────────┴──────────────────┴──────────────────╯   ╰──────────────────┴──────────────────┴──────────────────╯
)
