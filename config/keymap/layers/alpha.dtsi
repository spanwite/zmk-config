ZMK_LAYER(Alpha,
// ╭──────────────────┬──────────────────┬──────────────────┬──────────────────┬──────────────────┬──────────────────╮   ╭──────────────────┬──────────────────┬──────────────────┬──────────────────┬──────────────────┬──────────────────╮
     &kp GRAVE          &kp Q              &kp W              &kp E              &kp R              &kp T                  &kp Y              &kp U              &kp I              &kp O              &kp P              &kp LBKT
// ├──────────────────├──────────────────┼──────────────────┼──────────────────┼──────────────────┼──────────────────┤   ├──────────────────├──────────────────┼──────────────────┼──────────────────┼──────────────────┼──────────────────┤
     KP_CHANGE_LANG     &hml LGUI A        &hml LALT S        &hml LCTRL D       &hml LSHFT F       &kp G                  &kp H              &hmr RSHFT J       &hmr RCTRL K       &hmr RALT L        &hmr RGUI SEMI     &lt SHORTCUTS SQT 
// ├──────────────────├──────────────────┼──────────────────┼──────────────────┼──────────────────┼──────────────────┤   ├──────────────────├──────────────────┼──────────────────┼──────────────────┼──────────────────┼──────────────────┤
     &to ALPHA          &kp Z              &kp X              &kp C              &kp V              &kp B                  &kp N              &kp M              &kp COMMA          &kp DOT            &kp SLASH          &kp RBKT
// ╰──────────────────┴──────────────────┴──────────────────┼──────────────────┼──────────────────┼──────────────────┤   ├──────────────────├──────────────────┼──────────────────┼──────────────────┴──────────────────┴──────────────────╯
                                                              &lt_caps MEDIA 0   &lt_spc_dot NAV 0  &lt_ldr FN 0           &sk LSHFT          &lt_rpt SYM 0  &lt_num_row NUM_ROW NUM_ROW
//                                                          ╰──────────────────┴──────────────────┴──────────────────╯   ╰──────────────────┴──────────────────┴──────────────────╯
)

ZMK_LAYER(Shifted,
// ╭──────────────────┬──────────────────┬──────────────────┬──────────────────┬──────────────────┬──────────────────╮   ╭──────────────────┬──────────────────┬──────────────────┬──────────────────┬──────────────────┬──────────────────╮
     &kp LS(GRAVE)      &kp LS(Q)          &kp LS(W)          &kp LS(E)          &kp LS(R)          &kp LS(T)              &kp LS(Y)          &kp LS(U)          &kp LS(I)          &kp LS(O)          &kp LS(P)          &kp LS(LBKT) 
// ├──────────────────├──────────────────┼──────────────────┼──────────────────┼──────────────────┼──────────────────┤   ├──────────────────├──────────────────┼──────────────────┼──────────────────┼──────────────────┼──────────────────┤
     ___                &hml LGUI LS(A)    &hml LALT LS(S)    &hml LCTRL LS(D)   &hml LSHFT LS(F)   &kp LS(G)              &kp LS(H)          &hmr RSHFT LS(J)   &hmr RCTRL LS(K)   &hmr RALT LS(L)    &hmr RGUI LS(SEMI) &kp LS(SQT) 
// ├──────────────────├──────────────────┼──────────────────┼──────────────────┼──────────────────┼──────────────────┤   ├──────────────────├──────────────────┼──────────────────┼──────────────────┼──────────────────┼──────────────────┤
     ___                &kp LS(Z)          &kp LS(X)          &kp LS(C)          &kp LS(V)          &kp LS(B)              &kp LS(N)          &kp LS(M)          &kp LS(COMMA)      &kp LS(DOT)        &kp SLASH          &kp LS(RBKT)
// ╰──────────────────┴──────────────────┴──────────────────┼──────────────────┼──────────────────┼──────────────────┤   ├──────────────────├──────────────────┼──────────────────┼──────────────────┴──────────────────┴──────────────────╯
                                                              ___                ___                ___                    ___                ___                ___
//                                                          ╰──────────────────┴──────────────────┴──────────────────╯   ╰──────────────────┴──────────────────┴──────────────────╯
)
