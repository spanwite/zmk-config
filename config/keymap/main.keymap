#include <behaviors.dtsi>
#include <behaviors/num_word.dtsi>
#include <dt-bindings/zmk/keys.h>
#include <dt-bindings/zmk/bt.h>
#include <dt-bindings/zmk/mouse.h>

#include "zmk-helpers/helper.h"

#include "aliases.h"
#include "settings.dtsi"

/* Helpers */
#include "helpers/macros.h"
#include "helpers/combos.h"
#include "helpers/meh-keys.h"
#include "helpers/mod-morph.h"
#include "helpers/holdtap.h"

/* Behaviors */
#include "behaviors/alpha.dtsi"
#include "behaviors/symbols.dtsi"
#include "behaviors/navigation.dtsi"
#include "behaviors/functions.dtsi"

#if __has_include("behaviors/.local.dtsi")
	#include "behaviors/.local.dtsi"
#endif

/* Layers */
#include "layers/alpha.dtsi"
#include "layers/numbers.dtsi"
#include "layers/symbols.dtsi"
#include "layers/navigation.dtsi"
#include "layers/specific.dtsi"
#include "layers/games.dtsi"
#include "layers/function.dtsi"

/* Combos */
#include "combos/main.dtsi"
#include "combos/games.dtsi"

#include "leader.dtsi"
