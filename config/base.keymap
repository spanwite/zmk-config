#include <behaviors.dtsi>

#include <dt-bindings/zmk/keys.h>
#include <dt-bindings/zmk/bt.h>

#include "../zmk-nodefree-config/helper.h"

#include "../config-parts/helpers.dtsi"

#include "../config-parts/common/aliases.dtsi"
#include "../config-parts/common/settings.dtsi"
#include "../config-parts/common/behaviors.dtsi"

#include "../config-parts/features/symbols.dtsi"
#include "../config-parts/features/shortcuts.dtsi"
#include "../config-parts/features/thumbs.dtsi"
#include "../config-parts/features/win_power.dtsi"
#include "../config-parts/features/mouse.dtsi"

#include "../config-parts/layers/alpha.dtsi"
#include "../config-parts/layers/caps_word.dtsi"
#include "../config-parts/layers/numpad.dtsi"
#include "../config-parts/layers/num_row.dtsi"
#include "../config-parts/layers/mouse.dtsi"
#include "../config-parts/layers/nav.dtsi"
#include "../config-parts/layers/symbols.dtsi"
#include "../config-parts/layers/shortcuts.dtsi"
#include "../config-parts/layers/fn.dtsi"
#include "../config-parts/layers/game_fps.dtsi"
#include "../config-parts/layers/vlc_player.dtsi"
#include "../config-parts/layers/system.dtsi"

#include "../config-parts/combos.dtsi"