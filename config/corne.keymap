#include "zmk-helpers/key-labels/42.h"

#define KEYS_L LT0 LT1 LT2 LT3 LT4 LT5 LM0 LM1 LM2 LM3 LM4 LM5 LB0 LB1 LB2 LB3 LB4 LB5
#define KEYS_R RT0 RT1 RT2 RT3 RT4 RT5 RM0 RM1 RM2 RM3 RM4 RM5 RB0 RB1 RB2 RB3 RB4 RB5
#define KEYS_T LH2 LH1 LH0 RH0 RH1 RH2

#define OS_WINDOWS
#define SYMBOLS_CUSTOM_KEYBOARD_LAYOUT
/* #define SYMBOLS_WINDOWS_ALT_CODES */

#include "./keymap/main.keymap"
